## meta-box/conf/layer.conf
```bitbake
# We have a conf and classes directory, append to BBPATH
BBPATH .= ":${LAYERDIR}"

# We have a recipes directory, add to BBFILES
BBFILES += "${LAYERDIR}/recipes/*/*.bb          \
            ${LAYERDIR}/recipes/*/*.bbappend    \
            ${LAYERDIR}/recipes/*/*/*.bb         \
            ${LAYERDIR}/recipes/*/*/*.bbappend   \
            "

BBFILE_COLLECTIONS += "meta-box"
BBFILE_PATTERN_meta-box := "^${LAYERDIR}/"
BBFILE_PRIORITY_meta-box = "99"

# This should only be incremented on significant changes that will
# cause compatibility issues with other layers
LAYERVERSION_meta-box = "1"

LAYERDEPENDS_meta-box = "core openembedded-layer"

LAYERSERIES_COMPAT_meta-box = "zeus dunfell"
```

## meta-box/conf/machine/zbox-hd.conf
```bitbake
require conf/machine/cubietruck.conf

PREFERRED_VERSION_linux-mainline = "5.18.%"
```
